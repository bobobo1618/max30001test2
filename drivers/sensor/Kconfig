## drivers/sensor/Kconfig
```kconfig
# Copyright (c) 2021 Nordic Semiconductor ASA
# SPDX-License-Identifier: Apache-2.0

if SENSOR
rsource "max30001/Kconfig"
endif # SENSOR
```

## drivers/sensor/max30001/Kconfig
```kconfig
# Copyright (c) 2021 Nordic Semiconductor ASA
# SPDX-License-Identifier: Apache-2.0

config MAXIM_MAX30001
	bool "MAX30001 ECG sensor"
	default y
	depends on DT_HAS_MAXIM_MAX30001_ENABLED
    select GPIO
	select SPI
	help
	  Enable MAX30001 ECG sensor
```

## dts/bindings/sensor/maxim,max30001.yaml
```yaml
description: |
  MAX30001 ECG sensor

compatible: "maxim,max30001"

include: [spi-device.yaml]

properties:
  interrupt-gpios:
    type: phandle-array
    required: true
    description: Interrupt GPIO
```
